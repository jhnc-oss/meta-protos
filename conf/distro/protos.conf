## conf/distro/protos.conf
```bitbake
include conf/distro/poky.conf

DISTRO = "protos"
DISTRO_NAME = "protos (PROTOS Linux Distribution)"
DISTRO_CODENAME = "spice"
SDK_VENDOR = "-protossdk"
SDK_VERSION = "${DISTRO_VERSION}"

TARGET_VENDOR = "-protos"
```

## conf/layer.conf
```bitbake
# We have a conf and classes directory, add to BBPATH
BBPATH .= ":${LAYERDIR}"

# We have recipes-* directories, add to BBFILES
BBFILES += "${LAYERDIR}/recipes-*/*/*.bb \
            ${LAYERDIR}/recipes-*/*/*.bbappend"

BBFILE_COLLECTIONS += "meta-protos"
BBFILE_PATTERN_meta-protos = "^${LAYERDIR}/"

# enforce precedence over any other layer
BBFILE_PRIORITY_meta-protos = "8"

LAYERDEPENDS_meta-protos = "core"
LAYERVERSION_meta-protos = "1"
LAYERSERIES_COMPAT_meta-protos = "dunfell kirkstone"
```

## meta-oe/conf/layer.conf
```bitbake
# We have a conf and classes directory, add to BBPATH
BBPATH .= ":${LAYERDIR}"

# We have recipes-* directories, add to BBFILES
BBFILES += "${LAYERDIR}/recipes-*/*/*.bb \
            ${LAYERDIR}/recipes-*/*/*.bbappend"

BBFILE_COLLECTIONS += "meta-oe"
BBFILE_PATTERN_meta-oe = "^${LAYERDIR}/"

# enforce layer precedence
BBFILE_PRIORITY_meta-oe = "8"

LAYERDEPENDS_meta-oe = "core"
LAYERSERIES_COMPAT_meta-oe = "dunfell kirkstone scarthgap"
```

## meta-python/conf/layer.conf
```bitbake
# We have a conf and classes directory, add to BBPATH
BBPATH .= ":${LAYERDIR}"

# We have recipes-* directories, add to BBFILES
BBFILES += "${LAYERDIR}/recipes-*/*/*/*.bb \
            ${LAYERDIR}/recipes-*/*/*/*.bbappend \
            ${LAYERDIR}/recipes-*/*/*.bb \
            ${LAYERDIR}/recipes-*/*/*.bbappend \
"

BBFILE_COLLECTIONS += "python-layer"
BBFILE_PATTERN_python-layer = "^${LAYERDIR}/"

# enforce layer precedence
BBFILE_PRIORITY_python-layer = "8"

LAYERDEPENDS_python-layer = "core"
LAYERSERIES_COMPAT_python-layer = "dunfell kirkstone"
```

## meta/conf/layer.conf
```bitbake
# We have a conf and classes directory, add to BBPATH
BBPATH .= ":${LAYERDIR}"

# We have recipes-* directories, add to BBFILES
BBFILES += "${LAYERDIR}/recipes-*/*/*.bb \
            ${LAYERDIR}/recipes-*/*/*.bbappend"

BBFILE_COLLECTIONS += "meta"
BBFILE_PATTERN_meta = "^${LAYERDIR}/"

# enforce layer precedence
BBFILE_PRIORITY_meta = "8"

# This layer does not contain any .bb but a .bbclass file
BBFILE_PATTERN_IGNORE_EMPTY_meta = "1"

LAYERDEPENDS_meta = "core"
LAYERSERIES_COMPAT_meta = "dunfell kirkstone"
```
